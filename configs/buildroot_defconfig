## configs/buildroot_defconfig
```kconfig
BR2_riscv=y
BR2_RISCV_64=y
# PR: no ccache
BR2_CCACHE=n
BR2_ROOTFS_OVERLAY="../rootfs"
BR2_LINUX_KERNEL=y
# PR: Z
# BR2_LINUX_KERNEL_IMAGE=y
BR2_LINUX_KERNEL_ZIMAGE=y
BR2_LINUX_KERNEL_CUSTOM_GIT=y
BR2_LINUX_KERNEL_CUSTOM_REPO_URL="https://github.com/piecea/piton-linux.git"
BR2_LINUX_KERNEL_CUSTOM_REPO_VERSION="ariane_5.6-rc4"
BR2_LINUX_KERNEL_USE_CUSTOM_CONFIG=y
BR2_LINUX_KERNEL_CUSTOM_CONFIG_FILE="../configs/linux_defconfig"
BR2_PACKAGE_HOST_LINUX_HEADERS_CUSTOM_5_6=y
# BR2_LINUX_KERNEL_LATEST_VERSION=y
# BR2_LINUX_KERNEL_USE_ARCH_DEFAULT_CONFIG=y
# BR2_LINUX_KERNEL_PATCH="../configs/piton.patch"
# BR2_LINUX_KERNEL_CONFIG_FRAGMENT_FILES="../configs/piton_config.frag"
BR2_PACKAGE_BUSYBOX_CONFIG="../configs/busybox.config"
BR2_PACKAGE_DHRYSTONE=y
# PR: for fun
BR2_PACKAGE_ASCII_INVADERS=y
BR2_PACKAGE_MEMSTAT=y
BR2_PACKAGE_RAMSPEED=y
BR2_PACKAGE_NFS_UTILS=y
BR2_PACKAGE_LIBNFS=y
BR2_PACKAGE_ETHTOOL=y
# BR2_PACKAGE_IFUPDOWN_SCRIPTS is not set
BR2_PACKAGE_IPERF3=y
BR2_PACKAGE_IPROUTE2=y
BR2_PACKAGE_OPENSSH=y
BR2_PACKAGE_TCPDUMP=y
BR2_TARGET_ROOTFS_CPIO_GZIP=y
BR2_TARGET_ROOTFS_INITRAMFS=y
BR2_TARGET_ENABLE_ROOT_LOGIN=y

# PR: for libstdc++.so
BR2_TOOLCHAIN_BUILDROOT_CXX=y
# PR: Enable compiler OpenMP support 
BR2_GCC_ENABLE_OPENMP=y
```
